## drivers/amlogic/dvb/media_tree_aml/drivers/media/platform/meson/dvb/Kconfig
```kconfig
# SPDX-License-Identifier: GPL-2.0
config DVB_USB_TBS5530
        tristate "Turbosight TBS5530 support"
        depends on DVB_USB
	select DVB_PLL if MEDIA_SUBDRV_AUTOSELECT
	select DVB_CXD2878 if MEDIA_SUBDRV_AUTOSELECT
	select DVB_M88RS6060 if MEDIA_SUBDRV_AUTOSELECT
        help
          Say Y here to support the Turbosight TBS5530 USB2 DVB-T/T2/C/C2/S/S2/S2x ISDBT ATSC device 

config DVB_M88RS6060
        tristate "Montage Technology M88RS6060 Demodulation and tuner"
        depends on DVB_CORE && I2C 
        select REGMAP_I2C
        default m if !MEDIA_SUBDRV_AUTOSELECT
        help
          Say Y when you want to support this frontend.

config DVB_CXD2878
	tristate "sony cxd2878 family Dvb-T/T2/C(j83-a/b/c),ISDB-T/C,ATSC Demodulator" 
	depends on DVB_CORE && I2C 
	default m if !MEDIA_SUBDRV_AUTOSELECT
	help
	  Say Y when you want to support this frontend.
```
